## Kconfig
```kconfig
source "drivers/external_drivers/ipu/drivers/media/pci/intel-ipu4/Kconfig"
source "drivers/external_drivers/ipu/drivers/media/platform/intel-ipu4/Kconfig"
source "drivers/external_drivers/ipu/drivers/media/i2c/Kconfig"
source "drivers/external_drivers/ipu/drivers/media/i2c/crlmodule/Kconfig"
source "drivers/external_drivers/ipu/drivers/media/i2c/lc898122/Kconfig"
```

## drivers/media/i2c/Kconfig
```kconfig
config VIDEO_DW9714
	tristate "dw9714 voice coil support"
	select REGMAP_I2C
	depends on I2C && VIDEO_V4L2
	---help---
	This is a driver for the DW9714 camera lens voice coil.
```

## drivers/media/platform/intel-ipu4/Kconfig
```kconfig
config INTEL_IPU4_BXT_GT_PDATA
	tristate "Enable built in platform data for Broxton-GT"
	---help---
	Pre-ACPI system platform data is compiled inside kernel
```
